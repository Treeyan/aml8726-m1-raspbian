## drivers/amlogic/cardreader/Kconfig
```kconfig
#
# cardreader subsystem configuration
#

menu "Amlogic Card support"

config MESON_ONE_CARDREADER
	bool "Card reader support "
	default n

config SD_MMC
	bool "SD/MMC card driver support"
	default y
	depends on MESON_ONE_CARDREADER

config SDIO
	bool "sdio interface driver support"
	default y
	depends on MESON_ONE_CARDREADER
	select SD_MMC
	
config AM_ATA
	bool "ATA/ATAPI driver support"
	default n
	depends on MESON_ONE_CARDREADER

config CF
	bool "CF card driver support"
	default n
	depends on AM_ATA

config MS_MSPRO
	bool "MS/MSPRO card driver support"
	default n
	depends on MESON_ONE_CARDREADER

config XD
	bool "XD card driver support"
	default n
	depends on MESON_ONE_CARDREADER

config INAND
	bool "inand card driver support"
	default n
	depends on MESON_ONE_CARDREADER
	select SD_MMC
	
endmenu
```

## drivers/amlogic/rtc/Kconfig
```kconfig
#upport amlogic rtc

menu "Amlogic RTC support"

	if !RTC_CLASS
		comment "Need config 'Real Time Clock'"
	endif
	
	config AML_RTC
		bool "Amlogic RTC support"
		default n
		depends on ARCH_MESON_ONE && RTC_CLASS
	
		help
			This is amlogic inernal rtc driver

endmenu
```

## drivers/amlogic/uart/Kconfig
```kconfig
config SERIAL_MESON_ONE 
	tristate "Meson one serial port support" 
	depends on ARCH_MESON_ONE 
	select SERIAL_CORE 
	help 
		This enables the driver for the on-chip UARTs of the Amlogic 
		Meson One processors. 

config SERIAL_MESON_ONE_CONSOLE 
	bool "Support for console on meson one" 
	depends on SERIAL_MESON_ONE=y 
	select SERIAL_CORE_CONSOLE 
	select SERIAL_EARLYCON 
	help 
		Say Y here if you wish to use a Amlogic Meson One UART as the 
		system console (the system console is the device which 
		receives all kernel messages and warnings and which allows 
		logins in single user mode) as /dev/ttySx.

choice
        prompt "---SET ttyS0 for CONSOLE PORT"
        default AM_UART0_SET_PORT_A

config AM_UART0_SET_PORT_A
        bool "uart port A"
        depends on SERIAL_MESON_ONE
        select SERIAL_CORE
        select SERIAL_CORE_CONSOLE
        help
           hardware uart

config AM_UART0_SET_PORT_B
        bool "uart port B"
        depends on SERIAL_MESON_ONE
        select SERIAL_CORE
        select SERIAL_CORE_CONSOLE
        help
           hardware uart

endchoice
```
